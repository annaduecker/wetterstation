/*
 * ESP8266 set Baudrate
 * Ralf Bohnen, 2013
 * This example code is in the public domain.
*/

/* 
  For ESP8266 Version : 0018000902-AI03

    This program is for the MEGA or other devices with more than one serial outputs.

    WARNING !
    Do never connect the 3.3V pin from the ESP8266 with the 3.3V pin of the MEGA because:
    -------------------------------------------------------------------------------------
    MEGA description :
        - 3V3. A 3.3 volt supply generated by the on-board regulator. 
          Maximum current draw is 50 mA.
    -------------------------------------------------------------------------------------
    SUPPOSE AN EXTERNAL POWER SUPPLY WITH MINIMUM 300mA OUTPUT !!!
*/

long oldBaud = 9600;
long newBaud = 115200;

void setup()
{
  Serial.begin(115200); //FROM MEGA TO PC

  Serial1.begin(oldBaud); //FROM MEGA TO ESP8266
  delay(200);

  if (!resetESP8266()) {stopProgram ();}

  getVersion();

  if (setBaudrate(String(newBaud))) {
    Serial1.begin(newBaud);
    delay (200);
    if (!resetESP8266()) {stopProgram ();}
  }
}

void loop()
{

  /* add main program code here */

}

void stopProgram () {
  Serial.println ("PROGRAM STOPPED...CHECK WIRING AND PRESS RESET ");
  while(true) {delay(1000);} 
}

bool setBaudrate(String baud) {
  Serial1.println("AT+CIOBAUD=" + baud);
  Serial.print("AT+CIOBAUD=" + baud);
  String get;
  Serial1.flush();
  get = Serial1.readString();
  if (get.indexOf("OK") > 0) {Serial.println("...OK"); return true;}
  Serial.println("...ERROR");
  return false;
}

bool resetESP8266 () {
  Serial.print("AT+RST");
  Serial1.setTimeout(5000);
  Serial1.println("AT+RST");
    String get;
  Serial1.flush();
  while (Serial1.available() > 0) { get = Serial1.readString(); }
  if (get.indexOf("OK") > 0) {Serial.println("...OK"); return true;}
  Serial.println("...ERROR");
  return false; 
}

bool getVersion() {
  Serial1.println("AT+GMR");
  Serial.print("AT+GMR");
  String get;
  Serial1.flush();
  //while (Serial1.available() > 0) {
  Serial1.readStringUntil('\r\n');
  String Version = Serial1.readStringUntil('\r\n');
  get = Serial1.readString();
  if (get.endsWith("OK\r\n")) {Serial.println("...Version :" + Version); return true;}
  Serial.println("...ERROR");
  return false;
}
